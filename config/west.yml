## config/west.yml
```yaml
manifest:
  defaults:
      remote: urob
  
  remotes:
    - name: zmkfirmware
      url-base: https://github.com/zmkfirmware
    - name: urob
      url-base: https://github.com/urob
  projects:
    - name: zmk-helpers
      revision: main
      path: modules/helpers
    - name: zmk
      remote: zmkfirmware
      revision: main
      import: app/west.yml
  self:
    path: config
```
